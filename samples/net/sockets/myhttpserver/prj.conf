## CMakeLists.txt
```
# SPDX-License-Identifier: Apache-2.0

cmake_minimum_required(VERSION 3.13.1)

option(CIVETWEB_ENABLE_WEBSOCKETS "Enable websockets connections" ON)

# needed for civetweb - default of 8192 is not enough
add_compile_definitions(USE_STACK_SIZE=12288) 

find_package(Zephyr REQUIRED HINTS $ENV{ZEPHYR_BASE})
project(civetweb)

set(HTML_DYNAMIC_FILES buttons.htm switches.htm inputs.htm)
set(HTML_STATIC_FILES webshell.htm live_log.htm index.htm bootstrap.bundle.min.js bootstrap.min.css jquery-3.3.1.min.js)

target_sources(app PRIVATE src/main.c src/my_log_backend.c src/mysettings.c src/mygpio.c src/web_shell.c src/websocket.c
               src/libc_extensions.c src/cJSON.c src/cJSON_Utils.c)

foreach(HTML_FILE ${HTML_STATIC_FILES})
	generate_inc_file_for_target(app
		${CMAKE_CURRENT_SOURCE_DIR}/htm/${HTML_FILE}
		${CMAKE_CURRENT_SOURCE_DIR}/htm/${HTML_FILE}.gz.inc
      --gzip)
endforeach()

foreach(HTML_FILE ${HTML_DYNAMIC_FILES})
   add_custom_command(
      WORKING_DIRECTORY ${CMAKE_CURRENT_SOURCE_DIR}/htm
      COMMAND ./htm2c.sh ${HTML_FILE} > ${HTML_FILE}.c
      DEPENDS ${CMAKE_CURRENT_SOURCE_DIR}/htm/${HTML_FILE}
      DEPENDS ${CMAKE_CURRENT_SOURCE_DIR}/htm/htm2c.sh
      OUTPUT ${CMAKE_CURRENT_SOURCE_DIR}/htm/${HTML_FILE}.c
      COMMENT "Generating code for ${HTML_FILE}."
   )
   target_sources(app PRIVATE htm/${HTML_FILE}.c)
endforeach()
```

## sample.yaml
```
sample:
  description: HTTP server for nucleo_h743zi
  name: myhttpserver
```

## prj.conf
```kconfig
# General config
CONFIG_CIVETWEB=y

# pthreads
CONFIG_POSIX_API=y
CONFIG_PTHREAD_IPC=y
CONFIG_POSIX_MQUEUE=y
# thread count has to be 3 + num_threads parameter used in mg_start()
CONFIG_MAX_PTHREAD_COUNT=6

# logging
CONFIG_LOG_IMMEDIATE=y

# flash access
CONFIG_FLASH=y
CONFIG_SOC_FLASH_STM32=y
CONFIG_FLASH_SHELL=y
CONFIG_MPU_ALLOW_FLASH_WRITE=y

# networking
CONFIG_NETWORKING=y
#CONFIG_NET_IPV6 is not set
CONFIG_NET_IPV4=y
CONFIG_NET_ARP=y
CONFIG_NET_UDP=y
CONFIG_NET_DHCPV4=y
CONFIG_NET_STATISTICS=y
CONFIG_NET_MAX_CONTEXTS=16
CONFIG_NET_MAX_CONN=32
CONFIG_NET_TCP=y
CONFIG_NET_SOCKETS=y
CONFIG_NET_CONFIG_SETTINGS=y
CONFIG_NET_MGMT=y
CONFIG_NET_MGMT_EVENT=y
CONFIG_NET_BUF_POOL_USAGE=y
CONFIG_NET_BUF_DATA_SIZE=128
CONFIG_NET_PKT_TX_COUNT=64
CONFIG_NET_BUF_TX_COUNT=128
CONFIG_NET_PKT_RX_COUNT=64
CONFIG_NET_BUF_RX_COUNT=128
CONFIG_NET_TCP_TIME_WAIT_DELAY=0
CONFIG_NET_TCP_BACKLOG_SIZE=8
CONFIG_SNTP=y


CONFIG_TEST_RANDOM_GENERATOR=y

CONFIG_INIT_STACKS=y

CONFIG_REBOOT=y

CONFIG_SLIP_STATISTICS=n
CONFIG_NET_SHELL=y
CONFIG_KERNEL_SHELL=y
CONFIG_GPIO_SHELL=y
CONFIG_SHELL_BACKEND_TELNET=y

CONFIG_PRINTK=y

CONFIG_MINIMAL_LIBC_MALLOC_ARENA_SIZE=16384
CONFIG_NET_TX_STACK_SIZE=2048
CONFIG_NET_RX_STACK_SIZE=2048
CONFIG_ISR_STACK_SIZE=2048
CONFIG_MAIN_STACK_SIZE=2048
CONFIG_IDLE_STACK_SIZE=1024
CONFIG_NET_MGMT_EVENT_STACK_SIZE=1024

CONFIG_DNS_RESOLVER=y

# logging
CONFIG_NET_LOG=y
CONFIG_LOG=y
```

## src/main.c
```c
/*
 * Copyright (c) 2019 Antmicro Ltd
 *
 * SPDX-License-Identifier: Apache-2.0
 */

#include <logging/log.h>
LOG_MODULE_REGISTER(myhttpserver, LOG_LEVEL_DBG);

#include <zephyr.h>
#include <errno.h>
#include <stdio.h>

#include <net/net_if.h>
#include <net/net_core.h>
#include <net/net_context.h>
#include <net/net_mgmt.h>
#include <net/ethernet_mgmt.h>
#include <net/sntp.h>

#include <posix/pthread.h>
#include <posix/time.h>
#include <civetweb.h>

#include "my_log_backend.h"
#include "mysettings.h"
#include "mygpio.h"
#include "web_shell.h"
#include "websocket.h"
#include "cJSON.h"

#define HTTP_PORT	80
//#define HTTPS_PORT	4443

#define CIVETWEB_MAIN_THREAD_STACK_SIZE		CONFIG_MAIN_STACK_SIZE

/* Use samllest possible value of 1024 (see the line 18619 of civetweb.c) */
#define MAX_REQUEST_SIZE_BYTES			1024

// generated from html files
extern int button_handler(struct mg_connection *conn, void *cbdata);
extern int switches_handler(struct mg_connection *conn, void *cbdata);
extern int input_handler(struct mg_connection *conn, void *cbdata);

// pseude file system for static html files
struct file_def {
	const char path[128];
	const char mime[32];
	const char* data;
	size_t len;
};

static const char index_htm[] = {
	#include "../htm/index.htm.gz.inc"
};

static const char webshell_htm[] = {
	#include "../htm/webshell.htm.gz.inc"
};

static const char live_log_htm[] = {
	#include "../htm/live_log.htm.gz.inc"
};

static const char bootstrap_js[] = {
	#include "../htm/bootstrap.bundle.min.js.gz.inc"
};

static const char bootstrap_css[] = {
	#include "../htm/bootstrap.min.css.gz.inc"
};

static const char jquery_js[] = {
	#include "../htm/jquery-3.3.1.min.js.gz.inc"
};

struct file_def file_system[] = {
	{.path = "/", .mime = "text/html", .data = index_htm, .len = sizeof(index_htm)},
	{.path = "/webshell.htm", .mime = "text/html", .data = webshell_htm, .len = sizeof(webshell_htm)},
	{.path = "/live_log.htm", .mime = "text/html", .data = live_log_htm, .len = sizeof(live_log_htm)},
	{.path = "/bootstrap.bundle.min.js", .mime = "text/javascript", .data = bootstrap_js, .len = sizeof(bootstrap_js)},
	{.path = "/bootstrap.min.css", .mime = "text/css", .data = bootstrap_css, .len = sizeof(bootstrap_css)},
	{.path = "/jquery-3.3.1.min.js", .mime = "text/javascript", .data = jquery_js, .len = sizeof(jquery_js)},
};

K_THREAD_STACK_DEFINE(civetweb_stack, CIVETWEB_MAIN_THREAD_STACK_SIZE);

void log_proxy(const char* fmt, ...) {
	struct log_msg_ids src_level = {
		.domain_id = CONFIG_LOG_DOMAIN_ID,
		.level = LOG_LEVEL_INF,
		.source_id = (uint16_t)LOG_CURRENT_MODULE_ID()
	};

	va_list myargs;
	va_start(myargs, fmt);
	log_generic(src_level, fmt, myargs, LOG_STRDUP_CHECK_EXEC);
	va_end(myargs);
}

static struct net_mgmt_event_callback mgmt_cb;
static struct k_delayed_work sntp_timer;

void send_ok(struct mg_connection *conn, const char* mime_type) {
	mg_printf(conn,
		  "HTTP/1.1 200 OK\r\n"
		  "Content-Type: %s\r\n"
		  "Connection: close\r\n\r\n", mime_type);
}


void send_error(struct mg_connection *conn, const char *msg) {
	mg_printf(conn,
		  "HTTP/1.1 400 Bad Request\r\n"
		  "Content-Type: text/html\r\n"
		  "Connection: close\r\n\r\n");
	mg_printf(conn, "%s\n", msg);
	LOG_INF("HTTP error: %s", msg);
}

static int set_output_handler(struct mg_connection *conn, void *cbdata) {
	const struct mg_request_info *ri = mg_get_request_info(conn);
	char buffer[1024];
	int dlen = mg_read(conn, buffer, sizeof(buffer) - 1);
	cJSON *obj, *elem;

	if (0 != strcmp(ri->request_method, "POST")) {
		send_error(conn, "Only POST requests are allowed");
		return 400;
	}

	if ((dlen < 1) || (dlen >= sizeof(buffer))) {
		send_error(conn, "Invalid data size (no or exceeded maximum length)");
		return 400;
	}

	buffer[dlen] = 0;	
	LOG_INF("HTTP params: %s", buffer);

	obj = cJSON_Parse(buffer);
	if (obj == NULL) {
		send_error(conn, "Json parse error");
		return 400;
	}

	int64_t timer = 0;
	char *current_key = NULL;

	bool schema_ok = true;
	cJSON_ArrayForEach(elem, obj) {
		current_key = elem->string;
		if (current_key != NULL) {
			if (elem->type != cJSON_Number) {
				schema_ok = false;
				LOG_INF("error: element type for %s is not a number", current_key);	
			}
			if (0 == strcmp(current_key, "delay")) {
				if (elem->valueint >= 100 && elem->valueint <= 5000) {
					timer = elem->valueint;
				} else {
					schema_ok = false;
					LOG_INF("error: delay has to be in the range of [100..5000]");
				}
			} else if (get_output_by_name(current_key) >= 0) {
				if (elem->valueint != 0 && elem->valueint != 1) {
					schema_ok = false;
					LOG_INF("error: output value for %s is not 0 or 1", current_key);
				}
			} else {
				schema_ok = false;
				LOG_INF("error: output '%s' does not exist", current_key);
			}
		} else {
			schema_ok = false;
			LOG_INF("error: unexpected element in json object");	
		}
	}

	if (!schema_ok) {
		send_error(conn, "error: json object deviates from schema");
		return 400;
	}

	// schema is ok, so set outputs now
	cJSON_ArrayForEach(elem, obj) {
		current_key = elem->string;
		if (0 != strcmp(current_key, "delay")) {
			(void)set_output_by_name(current_key, elem->valueint, timer);
		}
	}

	cJSON_Delete(obj);
	send_ok(conn, "text/plain");
	return 200;
}

static int set_output_default_handler(struct mg_connection *conn, void *cbdata) {
	const struct mg_request_info *ri = mg_get_request_info(conn);

	if (0 != strcmp(ri->request_method, "POST")) {
		send_error(conn, "Only POST requests are allowed");
		return 400;
	}

	for (uint32_t i = 0; i < NUM_OUTPUTS; i++) {
		set_output(i, get_output(i)->default_value, 0);
	}

	send_ok(conn, "text/plain");
	return 200;
}

static int get_output_handler(struct mg_connection *conn, void *cbdata)
{
	send_ok(conn, "text/plain");

	mg_printf(conn, "{");
	for (uint32_t i = 0; i < NUM_OUTPUTS; i++) {
		mg_printf(conn, "%s \"%s\":%d", i == 0 ? "" : ",", get_output(i)->json_name, get_output(i)->value);		
	}
	mg_printf(conn, "}");

	return 200;
}

static int get_input_handler(struct mg_connection *conn, void *cbdata)
{
	send_ok(conn, "text/plain");

	mg_printf(conn, "{");
	for (uint32_t i = 0; i < NUM_INPUTS; i++) {
		mg_printf(conn, "%s \"%s\":%d", i == 0 ? "" : ",", get_input(i)->json_name, get_input_state(i));		
	}
	mg_printf(conn, "}");

	return 200;
}

static int webshell_cmd_handler(struct mg_connection *conn, void *cbdata)
{
	const struct mg_request_info *ri = mg_get_request_info(conn);
	char buffer[256];
	int dlen = mg_read(conn, buffer, sizeof(buffer) - 1);

	if (0 != strcmp(ri->request_method, "POST")) {
		send_error(conn, "Only POST requests are allowed");
		return 400;
	}

	if ((dlen < 1) || (dlen >= sizeof(buffer))) {
		send_error(conn, "Invalid data size (no or exceeded maximum length)");
		return 400;
	}

	buffer[dlen] = 0;	
	LOG_INF("HTTP params: %s", buffer);

	send_ok(conn, "text/plain");

	shell_backend_dummy_clear_output(shell_backend_dummy_get_ptr());
	shell_execute_cmd(shell_backend_dummy_get_ptr(), buffer);

	size_t out_len;
	const char* out_buf;
	out_buf = shell_backend_dummy_get_output(shell_backend_dummy_get_ptr(), &out_len);

	mg_write(conn, out_buf, out_len);

	mg_printf(conn, "\n");

	return 200;
}

static int get_log_handler(struct mg_connection *conn, void *cbdata)
{
	char line[MY_LOG_BACKEND_RB_SLOT_SIZE];

	send_ok(conn, "text/plain");

	for (bool end = log_get_next_line(true, line); !end; end = log_get_next_line(false, line)) {
		mg_printf(conn, "%s", line);	
	}
	return 200;
}

static int file_system_handler(struct mg_connection *conn, void *cbdata)
{
	const struct mg_request_info *ri = mg_get_request_info(conn);

	for (uint32_t i = 0; i < sizeof(file_system)/sizeof(file_system)[0]; i++) {
		if (0 == strcmp(ri->request_uri, file_system[i].path)) {
			mg_printf(conn,
				"HTTP/1.1 200 OK\r\n"
				"Content-Type: %s\r\n"
				"Content-Encoding: gzip\r\n"
				"Connection: close\r\n\r\n", file_system[i].mime);
			mg_write(conn, file_system[i].data, file_system[i].len);
			return 200;
		}
	}

	mg_printf(conn,
		  "HTTP/1.1 404 Not Found\r\n"
		  "Content-Type: text/html\r\n"
		  "Connection: close\r\n\r\n");
	LOG_INF("Requested page not available");

	return 404;
}

static void *main_pthread(void *arg)
{
	LOG_INF("main_pthread");

	static const char * const options[] = {
		"listening_ports",
		STRINGIFY(HTTP_PORT),
		"num_threads",
		"3",
		"max_request_size",
		STRINGIFY(MAX_REQUEST_SIZE_BYTES),
		NULL
	};

	struct mg_callbacks callbacks;
	struct mg_context *ctx;

	(void)arg;

	memset(&callbacks, 0, sizeof(callbacks));
	ctx = mg_start(&callbacks, 0, (const char **)options);

	if (ctx == NULL) {
		printf("Unable to start the server.");
		return 0;
	}

	mg_set_request_handler(ctx, "/log$", get_log_handler, 0);
	mg_set_request_handler(ctx, "/shell$", webshell_cmd_handler, 0);
	mg_set_request_handler(ctx, "/get_outputs$", get_output_handler, 0);
	mg_set_request_handler(ctx, "/get_inputs$", get_input_handler, 0);
	mg_set_request_handler(ctx, "/set_outputs$", set_output_handler, 0);
	mg_set_request_handler(ctx, "/set_default$", set_output_default_handler, 0);
	mg_set_request_handler(ctx, "/buttons$", button_handler, 0);
	mg_set_request_handler(ctx, "/switches$", switches_handler, 0);
	mg_set_request_handler(ctx, "/inputs$", input_handler, 0);
	mg_set_request_handler(ctx, "/", file_system_handler, 0);

	init_websocket_server_handlers(ctx); // this call will not return
	return 0;
}

static void get_time_from_sntp(struct k_work *work) {
	struct sntp_time ts;
	struct timespec tspec;
	int res = sntp_simple(get_settings()->sntp_server, 3000, &ts);

	if (res < 0) {
		LOG_ERR("Cannot set time using SNTP");
		return;
	}

	tspec.tv_sec = ts.seconds;
	tspec.tv_nsec = ((uint64_t)ts.fraction * (1000 * 1000 * 1000)) >> 32;
	res = clock_settime(CLOCK_REALTIME, &tspec);

	LOG_INF("Setup clock via sntp");
}

static void net_mgmt_event_handler(struct net_mgmt_event_callback *cb,
		    uint32_t mgmt_event,
		    struct net_if *iface)
{
	if (mgmt_event != NET_EVENT_IPV4_ADDR_ADD) {
		return;
	}

	// run it from work queue because task of network management thread is very small
	k_delayed_work_init(&sntp_timer, get_time_from_sntp);
	k_delayed_work_submit(&sntp_timer, K_NO_WAIT);
}

void main(void)
{
	net_mgmt_init_event_callback(&mgmt_cb, net_mgmt_event_handler,
				     NET_EVENT_IPV4_ADDR_ADD);
	net_mgmt_add_event_callback(&mgmt_cb);

	init_gpios();

	pthread_attr_t civetweb_attr;
	pthread_t civetweb_thread;

	LOG_INF("Run http server");
	(void)pthread_attr_init(&civetweb_attr);
	(void)pthread_attr_setstack(&civetweb_attr, &civetweb_stack,
				    CIVETWEB_MAIN_THREAD_STACK_SIZE);

	(void)pthread_create(&civetweb_thread, &civetweb_attr,
			     &main_pthread, 0);

	// now check output timeouts
	while (true) {
		check_output_timer();
		k_msleep(100);
	}
}
```

## src/libc_extensions.c
```c
/*
 * Copyright (c) 2019 Antmicro Ltd
 *
 * SPDX-License-Identifier: Apache-2.0
 */

#include <logging/log.h>
LOG_MODULE_REGISTER(lib_extensions, LOG_LEVEL_DBG);

#include <zephyr.h>
#include <string.h>
#include <stdio.h>
#include <stdlib.h>

#include "libc_extensions.h"

#define FN_MISSING() LOG_DBG("[IMPLEMENTATION MISSING : %s]", __func__)

int iscntrl(int c)
{
	/* All the characters placed before the space on the ASCII table
	 * and the 0x7F character (DEL) are control characters.
	 */
	return (int)(c < ' ' || c == 0x7F);
}

size_t strftime(char *dst, size_t dst_size,
		const char *fmt,
		const struct tm *tm)
{
	FN_MISSING();

	return 0;
}

double difftime(time_t end, time_t beg)
{
	return end - beg;
}

struct __strerr_wrap {
	int err;
	const char *errstr;
};

/* Implementation suggested by @rakons in #16527 */
#define STRERR_DEFINE(e)	{e, #e}

static const struct __strerr_wrap error_strings[] = {
	STRERR_DEFINE(EILSEQ),
	STRERR_DEFINE(EDOM),
	STRERR_DEFINE(ERANGE),
	STRERR_DEFINE(ENOTTY),
	STRERR_DEFINE(EACCES),
	STRERR_DEFINE(EPERM),
	STRERR_DEFINE(ENOENT),
	STRERR_DEFINE(ESRCH),
	STRERR_DEFINE(EEXIST),
	STRERR_DEFINE(ENOSPC),
	STRERR_DEFINE(ENOMEM),
	STRERR_DEFINE(EBUSY),
	STRERR_DEFINE(EINTR),
	STRERR_DEFINE(EAGAIN),
	STRERR_DEFINE(ESPIPE),
	STRERR_DEFINE(EXDEV),
	STRERR_DEFINE(EROFS),
	STRERR_DEFINE(ENOTEMPTY),
	STRERR_DEFINE(ECONNRESET),
	STRERR_DEFINE(ETIMEDOUT),
	STRERR_DEFINE(ECONNREFUSED),
	STRERR_DEFINE(EHOSTDOWN),
	STRERR_DEFINE(EHOSTUNREACH),
	STRERR_DEFINE(EADDRINUSE),
	STRERR_DEFINE(EPIPE),
	STRERR_DEFINE(EIO),
	STRERR_DEFINE(ENXIO),
	STRERR_DEFINE(ENOTBLK),
	STRERR_DEFINE(ENODEV),
	STRERR_DEFINE(ENOTDIR),
	STRERR_DEFINE(EISDIR),
	STRERR_DEFINE(ETXTBSY),
	STRERR_DEFINE(ENOEXEC),
	STRERR_DEFINE(EINVAL),
	STRERR_DEFINE(E2BIG),
	STRERR_DEFINE(ELOOP),
	STRERR_DEFINE(ENAMETOOLONG),
	STRERR_DEFINE(ENFILE),
	STRERR_DEFINE(EMFILE),
	STRERR_DEFINE(EBADF),
	STRERR_DEFINE(ECHILD),
	STRERR_DEFINE(EFAULT),
	STRERR_DEFINE(EFBIG),
	STRERR_DEFINE(EMLINK),
	STRERR_DEFINE(ENOLCK),
	STRERR_DEFINE(EDEADLK),
	STRERR_DEFINE(ECANCELED),
	STRERR_DEFINE(ENOSYS),
	STRERR_DEFINE(ENOMSG),
	STRERR_DEFINE(ENOSTR),
	STRERR_DEFINE(ENODATA),
	STRERR_DEFINE(ETIME),
	STRERR_DEFINE(ENOSR),
	STRERR_DEFINE(EPROTO),
	STRERR_DEFINE(EBADMSG),
	STRERR_DEFINE(ENOTSOCK),
	STRERR_DEFINE(EDESTADDRREQ),
	STRERR_DEFINE(EMSGSIZE),
	STRERR_DEFINE(EPROTOTYPE),
	STRERR_DEFINE(ENOPROTOOPT),
	STRERR_DEFINE(EPROTONOSUPPORT),
	STRERR_DEFINE(ESOCKTNOSUPPORT),
	STRERR_DEFINE(ENOTSUP),
	STRERR_DEFINE(EPFNOSUPPORT),
	STRERR_DEFINE(EAFNOSUPPORT),
	STRERR_DEFINE(EADDRNOTAVAIL),
	STRERR_DEFINE(ENETDOWN),
	STRERR_DEFINE(ENETUNREACH),
	STRERR_DEFINE(ENETRESET),
	STRERR_DEFINE(ECONNABORTED),
	STRERR_DEFINE(ENOBUFS),
	STRERR_DEFINE(EISCONN),
	STRERR_DEFINE(ENOTCONN),
	STRERR_DEFINE(ESHUTDOWN),
	STRERR_DEFINE(EALREADY),
	STRERR_DEFINE(EINPROGRESS),
};

static char *strerr_unknown = "UNKNOWN";

char *strerror(int err)
{
	int i;

	for (i = 0; i < ARRAY_SIZE(error_strings); ++i) {
		if (error_strings[i].err == err) {
			return (char *)error_strings[i].errstr;
		}
	}

	return strerr_unknown;
}

int sscanf(const char *s, const char *format, ...)
{
	FN_MISSING();

	return 0;
}

double atof(const char *str)
{
	/* XXX good enough for civetweb uses */
	return (double)atoi(str);
}

long long strtoll(const char *str, char **endptr, int base)
{
	/* XXX good enough for civetweb uses */
	return (long long)strtol(str, endptr, base);
}

time_t time(time_t *t)
{
	return 0;
}

/*
 * Most of the wrappers below are copies of the wrappers in net/sockets.h,
 * but they are available only if CONFIG_NET_SOCKETS_POSIX_NAMES is enabled
 * which is impossible here.
 */

int getsockname(int sock, struct sockaddr *addr,
		socklen_t *addrlen)
{
	return zsock_getsockname(sock, addr, addrlen);
}

int poll(struct zsock_pollfd *fds, int nfds, int timeout)
{
	return zsock_poll(fds, nfds, timeout);
}

int getnameinfo(const struct sockaddr *addr, socklen_t addrlen,
		char *host, socklen_t hostlen,
		char *serv, socklen_t servlen, int flags)
{
	return zsock_getnameinfo(addr, addrlen, host, hostlen,
				 serv, servlen, flags);
}

ssize_t send(int sock, const void *buf, size_t len, int flags)
{
	return zsock_send(sock, buf, len, flags);
}

ssize_t recv(int sock, void *buf, size_t max_len, int flags)
{
	return zsock_recv(sock, buf, max_len, flags);
}

int socket(int family, int type, int proto)
{
	return zsock_socket(family, type, proto);
}

int getaddrinfo(const char *host, const char *service,
		const struct zsock_addrinfo *hints,
		struct zsock_addrinfo **res)
{
	return zsock_getaddrinfo(host, service, hints, res);
}

void freeaddrinfo(struct zsock_addrinfo *ai)
{
	zsock_freeaddrinfo(ai);
}

int connect(int sock, const struct sockaddr *addr,
	    socklen_t addrlen)
{
	return zsock_connect(sock, addr, addrlen);
}

int getsockopt(int sock, int level, int optname,
	       void *optval, socklen_t *optlen)
{
	return zsock_getsockopt(sock, level, optname, optval, optlen);
}

int setsockopt(int sock, int level, int optname,
	       const void *optval, socklen_t optlen)
{
	return zsock_setsockopt(sock, level, optname, optval, optlen);
}

int listen(int sock, int backlog)
{
	return zsock_listen(sock, backlog);
}

int bind(int sock, const struct sockaddr *addr, socklen_t addrlen)
{
	return zsock_bind(sock, addr, addrlen);
}

int accept(int sock, struct sockaddr *addr, socklen_t *addrlen)
{
	return zsock_accept(sock, addr, addrlen);
}
```

## src/log_backend_rb.c
```c
/*
 * Copyright (c) 2019 Intel Corporation
 *
 * SPDX-License-Identifier: Apache-2.0
 */

#include <logging/log_backend.h>
#include <logging/log_core.h>
#include <logging/log_msg.h>
#include <logging/log_output.h>
#include <sys/byteorder.h>
#include <sys/ring_buffer.h>
#include <shell/shell.h>

#include "log_backend_rb.h"

static struct ring_buf ringbuf;

/*
 * Log message format:
 * Logging started with magic number 0x55aa followed by log message id.
 * Log message ended with null terminator and takes
 * CONFIG_LOG_BACKEND_RB_SLOT_SIZE slot. The long log message can occupy
 * several logging slots.
 */

/*
 * All log messages are split to similar sized logging slots. Since ring
 * buffer slots get rewritten we need to check that all slots are fit to
 * the ring buffer
 */
BUILD_ASSERT(CONFIG_LOG_BACKEND_RB_MEM_SIZE %
	     CONFIG_LOG_BACKEND_RB_SLOT_SIZE == 0);

static void init(void)
{
	ring_buf_init(&ringbuf, CONFIG_LOG_BACKEND_RB_MEM_SIZE,
		      (void *)CONFIG_LOG_BACKEND_RB_MEM_BASE);
}

static void trace(const uint8_t *data, size_t length)
{
	const uint16_t magic = 0x55aa;
	static uint16_t log_id;
	volatile uint8_t *t, *region;
	int space;

	space = ring_buf_space_get(&ringbuf);
	if (space < CONFIG_LOG_BACKEND_RB_SLOT_SIZE) {
		uint8_t *dummy;

		/* Remove oldest entry */
		ring_buf_get_claim(&ringbuf, &dummy,
				   CONFIG_LOG_BACKEND_RB_SLOT_SIZE);
		ring_buf_get_finish(&ringbuf, CONFIG_LOG_BACKEND_RB_SLOT_SIZE);
	}

	ring_buf_put_claim(&ringbuf, (uint8_t **)&t,
			   CONFIG_LOG_BACKEND_RB_SLOT_SIZE);
	region = t;

	/* Add magic number at the beginning of the slot */
	sys_put_le16(magic, (uint8_t *)t);
	t += 2;

	/* Add log id */
	sys_put_le16(log_id++, (uint8_t *)t);
	t += 2;

	length = MIN(length, CONFIG_LOG_BACKEND_RB_SLOT_SIZE - 4);

	memcpy((void *)t, data, length);
	t += length;

	memset((void *)t, 0,
		       CONFIG_LOG_BACKEND_RB_SLOT_SIZE - 4 - length);

	ring_buf_put_finish(&ringbuf, CONFIG_LOG_BACKEND_RB_SLOT_SIZE);
}

static int char_out(uint8_t *data, size_t length, void *ctx)
{
	static uint32_t index = 0;
	static uint8_t immediate_buffer[CONFIG_LOG_BACKEND_RB_SLOT_SIZE - 4];

	if (length == 0) {
		trace(immediate_buffer, index);
		index = 0;
	} else if (length == 1) {
		immediate_buffer[index++] = *data;
		if (index == sizeof(immediate_buffer) - 1) {
			trace(immediate_buffer, index);
			index = 0;
		}
	} else {
		trace(data, length);
		index = 0;		
	}

	return length;
}

/* magic and log id takes space */
static uint8_t rb_log_buf[CONFIG_LOG_BACKEND_RB_SLOT_SIZE - 4];

LOG_OUTPUT_DEFINE(log_output_rb, char_out, rb_log_buf, sizeof(rb_log_buf));

static void put(const struct log_backend *const backend,
		struct log_msg *msg)
{
	uint32_t flags = LOG_OUTPUT_FLAG_LEVEL;

	log_msg_get(msg);

	flags |= LOG_OUTPUT_FLAG_TIMESTAMP;
	flags |= LOG_OUTPUT_FLAG_FORMAT_TIMESTAMP;

	log_output_msg_process(&log_output_rb, msg, flags);

	log_msg_put(msg);
}

static void panic(struct log_backend const *const backend)
{
	log_output_flush(&log_output_rb);
}

static void dropped(const struct log_backend *const backend, uint32_t cnt)
{
	ARG_UNUSED(backend);

	log_output_dropped_process(&log_output_rb, cnt);
}

static void sync_string(const struct log_backend *const backend,
			struct log_msg_ids src_level, uint32_t timestamp,
			const char *fmt, va_list ap)
{
	uint32_t flags = LOG_OUTPUT_FLAG_LEVEL;
	uint32_t key;

	flags |= LOG_OUTPUT_FLAG_TIMESTAMP;
	flags |= LOG_OUTPUT_FLAG_FORMAT_TIMESTAMP;

	key = irq_lock();
	log_output_string(&log_output_rb, src_level,
			  timestamp, fmt, ap, flags);
	irq_unlock(key);
}

static void sync_hexdump(const struct log_backend *const backend,
			 struct log_msg_ids src_level, uint32_t timestamp,
			 const char *metadata, const uint8_t *data, uint32_t length)
{
	uint32_t flags = LOG_OUTPUT_FLAG_LEVEL;
	uint32_t key;

	flags |= LOG_OUTPUT_FLAG_TIMESTAMP;
	flags |= LOG_OUTPUT_FLAG_FORMAT_TIMESTAMP;

	key = irq_lock();
	log_output_hexdump(&log_output_rb, src_level, timestamp,
			   metadata, data, length, flags);
	irq_unlock(key);
}

const struct log_backend_api log_backend_rb_api = {
	.put = IS_ENABLED(CONFIG_LOG_IMMEDIATE) ? NULL : put,
	.put_sync_string = IS_ENABLED(CONFIG_LOG_IMMEDIATE) ?
			sync_string : NULL,
	.put_sync_hexdump = IS_ENABLED(CONFIG_LOG_IMMEDIATE) ?
			sync_hexdump : NULL,
	.panic = panic,
	.init = init,
	.dropped = IS_ENABLED(CONFIG_LOG_IMMEDIATE) ? NULL : dropped,
};

LOG_BACKEND_DEFINE(log_backend_rb, log_backend_rb_api, true);

// interface
bool log_get_next_line(bool begin, char line[CONFIG_LOG_BACKEND_RB_SLOT_SIZE]) {
	static uint32_t index = 0; // not thread safe - when used in parallel, not all lines will be shown
	bool end = false;
	if (begin) {
		index = ringbuf.head;
	}
	if (index != ringbuf.tail) {
		memcpy(line, &ringbuf.buf.buf8[(index & ringbuf.mask) + 4], CONFIG_LOG_BACKEND_RB_SLOT_SIZE - 4);
		line[CONFIG_LOG_BACKEND_RB_SLOT_SIZE - 4] = '\0';
		index += CONFIG_LOG_BACKEND_RB_SLOT_SIZE;
	} else {
		end = true;
	};
	return end;
}

void log_buffer_clear() {
	ring_buf_reset(&ringbuf);
}

// shell commands

static int cmd_show(const struct shell *shell, size_t argc, char **argv) {
	char line[CONFIG_LOG_BACKEND_RB_SLOT_SIZE];

	for (bool end = log_get_next_line(true, line); !end; end = log_get_next_line(false, line)) {
		shell_fprintf(shell, SHELL_NORMAL, "%s", line);
	}

	return 0;
}

static int cmd_clear(const struct shell *shell, size_t argc, char **argv) {
	log_buffer_clear();
	return 0;
}

SHELL_STATIC_SUBCMD_SET_CREATE(sub_ramlog,
	SHELL_CMD(show, NULL, "Show whole log", cmd_show),
	SHELL_CMD(clear, NULL, "Clear whole log", cmd_clear),
	SHELL_SUBCMD_SET_END
);

SHELL_CMD_REGISTER(ramlog, &sub_ramlog, "RAMlog commands", NULL);
```

## src/log_backend_rb.h
```c
#ifndef LOG_BACKEND_RB_H_
#define LOG_BACKEND_RB_H_

#ifdef __cplusplus
extern "C" {
#endif

#define CONFIG_LOG_BACKEND_RB_MEM_BASE 0x24070000
#define CONFIG_LOG_BACKEND_RB_MEM_SIZE 65536U
#define CONFIG_LOG_BACKEND_RB_SLOT_SIZE 64U

extern bool log_get_next_line(bool begin, char line[CONFIG_LOG_BACKEND_RB_SLOT_SIZE]);
extern void log_buffer_clear();

#ifdef __cplusplus
}
#endif

#endif /* LOG_BACKEND_RB_H_ */
```

## src/my_log_backend.c
```c
/*
 * Copyright (c) 2019 Intel Corporation
 *
 * SPDX-License-Identifier: Apache-2.0
 */

#include <logging/log_backend.h>
#include <logging/log_ctrl.h>
#include <logging/log_msg.h>
#include <sys/byteorder.h>
#include <sys/ring_buffer.h>
#include <shell/shell.h>
#include <time.h>
#include <stdio.h>

#include "my_log_backend.h"

static struct ring_buf ringbuf;
static uint8_t my_ringbuf_buffer[MY_LOG_BACKEND_RB_MEM_SIZE];
/*
 * Log message format:
 * Logging started with magic number 0x55aa followed by log message id.
 * Log message ended with null terminator and takes
 * CONFIG_LOG_BACKEND_RB_SLOT_SIZE slot. The long log message can occupy
 * several logging slots.
 */

/*
 * All log messages are split to similar sized logging slots. Since ring
 * buffer slots get rewritten we need to check that all slots are fit to
 * the ring buffer
 */
BUILD_ASSERT(MY_LOG_BACKEND_RB_MEM_SIZE % MY_LOG_BACKEND_RB_SLOT_SIZE == 0);

static void(*listener_callback)(const char*) = NULL;

void log_register_listener(void(*fun_ptr)(const char*)) {
	listener_callback = fun_ptr;
}

static void init(void)
{
	ring_buf_init(&ringbuf, sizeof(my_ringbuf_buffer), my_ringbuf_buffer);
}

static void trace(const uint8_t *data, size_t length)
{
	const uint16_t magic = 0x55aa;
	static uint16_t log_id;
	volatile uint8_t *t, *region;
	int space;

	space = ring_buf_space_get(&ringbuf);
	if (space < MY_LOG_BACKEND_RB_SLOT_SIZE) {
		uint8_t *dummy;

		/* Remove oldest entry */
		ring_buf_get_claim(&ringbuf, &dummy,
				   MY_LOG_BACKEND_RB_SLOT_SIZE);
		ring_buf_get_finish(&ringbuf, MY_LOG_BACKEND_RB_SLOT_SIZE);
	}

	ring_buf_put_claim(&ringbuf, (uint8_t **)&t,
			   MY_LOG_BACKEND_RB_SLOT_SIZE);
	region = t;

	/* Add magic number at the beginning of the slot */
	sys_put_le16(magic, (uint8_t *)t);
	t += 2;

	/* Add log id */
	sys_put_le16(log_id++, (uint8_t *)t);
	t += 2;

	length = MIN(length, MY_LOG_BACKEND_RB_SLOT_SIZE - 4);

	memcpy((void *)t, data, length);
	t += length;

	memset((void *)t, 0, MY_LOG_BACKEND_RB_SLOT_SIZE - 4 - length);

	ring_buf_put_finish(&ringbuf, MY_LOG_BACKEND_RB_SLOT_SIZE);
}

static const char *const severity[] = {
	NULL,
	"err",
	"wrn",
	"inf",
	"dbg"
};

static int insert_timestamp(char* buffer, uint32_t timestamp)
{
	int length = 0;

	struct timespec tp;
	int res = clock_gettime(CLOCK_REALTIME, &tp);
	if (res == 0) {
		uint32_t act_timestamp;
		uint32_t act_freq;
		uint32_t timestamp_diff;
		uint32_t ns_delta;
		uint32_t s_delta;
		struct tm tm;

		// correct difference of timestamp from log and current time
		if (sys_clock_hw_cycles_per_sec() > 1000000) {
			act_timestamp = k_uptime_get_32();
			act_freq = 1000;
		} else {
			act_timestamp = k_cycle_get_32();
			act_freq = sys_clock_hw_cycles_per_sec();
		}

		// remainder = timestamp % freq;
		// ms = (remainder * 1000U) / freq;
		// us = (1000 * (remainder * 1000U - (ms * freq))) / freq;

		timestamp_diff = (act_timestamp - timestamp);
		ns_delta = (((timestamp_diff % act_freq) * 1000U) / act_freq) * 1000000U;
		s_delta = timestamp_diff / act_freq;
		tp.tv_sec -= s_delta;

		if (tp.tv_nsec + 1000000000U - ns_delta >= 1000000000U) {
			tp.tv_nsec -= ns_delta;
		} else {
			tp.tv_nsec += (1000000000U - ns_delta);
			tp.tv_sec -= 1U;
		}

		gmtime_r(&tp.tv_sec, &tm);
		length = sprintf(buffer,
			"%d-%02u-%02u %02u:%02u:%02u:%03u ",
		    tm.tm_year + 1900,
		    tm.tm_mon + 1,
		    tm.tm_mday,
		    tm.tm_hour,
		    tm.tm_min,
		    tm.tm_sec,
			 (unsigned int)(tp.tv_nsec / 1000000U));

	}
	return length;
}

static void sync_string(const struct log_backend *const backend,
			struct log_msg_ids src_level, uint32_t timestamp,
			const char *fmt, va_list ap)
{
	char buf[256];
	int index = 0;

	index += insert_timestamp(buf, timestamp);
	index += snprintf(buf + index, sizeof(buf) - index, "<%s> %s: ", 
		severity[src_level.level], log_source_name_get(src_level.domain_id, src_level.source_id));
	index += vsnprintf(buf + index, sizeof(buf) - index, fmt, ap);

	index = MIN(sizeof(buf) - 2, index);
	buf[index]='\n';
	buf[index+1]='\0';

	// add line to ramlog
	for (uint32_t i = 0; i < strlen(buf) + 1; i += (MY_LOG_BACKEND_RB_SLOT_SIZE - 4)) {
		trace(buf + i,  MIN((strlen(buf) + 1 - i), (MY_LOG_BACKEND_RB_SLOT_SIZE - 4)));
	}

	// send line to websocket 
	if (listener_callback) {
		listener_callback(buf);
	}
}

const struct log_backend_api my_log_backend_api = {
	.put = NULL,
	.put_sync_string = sync_string,
	.put_sync_hexdump = NULL,
	.panic = NULL,
	.init = init,
	.dropped =  NULL,
};

LOG_BACKEND_DEFINE(my_log_backend, my_log_backend_api, true);

// interface
bool log_get_next_line(bool begin, char line[MY_LOG_BACKEND_RB_SLOT_SIZE]) {
	static uint32_t index = 0; // not thread safe - when used in parallel, not all lines will be shown
	bool end = false;
	if (begin) {
		index = ringbuf.head;
	}
	if (index != ringbuf.tail) {
		memcpy(line, &ringbuf.buf.buf8[(index & ringbuf.mask) + 4], MY_LOG_BACKEND_RB_SLOT_SIZE - 4);
		line[MY_LOG_BACKEND_RB_SLOT_SIZE - 4] = '\0';
		index += MY_LOG_BACKEND_RB_SLOT_SIZE;
	} else {
		end = true;
	};
	return end;
}

void log_buffer_clear() {
	ring_buf_reset(&ringbuf);
}

// shell commands

static int cmd_show(const struct shell *shell, size_t argc, char **argv) {
	char line[MY_LOG_BACKEND_RB_SLOT_SIZE];

	for (bool end = log_get_next_line(true, line); !end; end = log_get_next_line(false, line)) {
		shell_fprintf(shell, SHELL_NORMAL, "%s", line);
	}

	return 0;
}

static int cmd_clear(const struct shell *shell, size_t argc, char **argv) {
	log_buffer_clear();
	return 0;
}

SHELL_STATIC_SUBCMD_SET_CREATE(sub_ramlog,
	SHELL_CMD(show, NULL, "Show whole log", cmd_show),
	SHELL_CMD(clear, NULL, "Clear whole log", cmd_clear),
	SHELL_SUBCMD_SET_END
);

SHELL_CMD_REGISTER(ramlog, &sub_ramlog, "RAMlog commands", NULL);
```

## src/my_log_backend.h
```c
#ifndef LOG_BACKEND_RB_H_
#define LOG_BACKEND_RB_H_

#ifdef __cplusplus
extern "C" {
#endif

#define MY_LOG_BACKEND_RB_MEM_SIZE 65536U
#define MY_LOG_BACKEND_RB_SLOT_SIZE 64U

extern bool log_get_next_line(bool begin, char line[MY_LOG_BACKEND_RB_SLOT_SIZE]);
extern void log_buffer_clear();
extern void log_register_listener(void(*fun_ptr)(const char*));

#ifdef __cplusplus
}
#endif

#endif /* LOG_BACKEND_RB_H_ */
```

## src/mygpio.c
```c
#include "mygpio.h"
#include <drivers/gpio.h>
#include <logging/log.h>
LOG_MODULE_DECLARE(myhttpserver, LOG_LEVEL_DBG);

struct output_struct outputs[NUM_OUTPUTS] = {0};
struct input_struct inputs[NUM_INPUTS] = {0};

static struct gpio_callback input_cb_data;

static void(*listener_callback)(const char*, uint8_t) = NULL;

void mygpio_register_listener(void(*fun_ptr)(const char*, uint8_t)) {
	listener_callback = fun_ptr;
}

static void gpio_listener(const char* json_name, uint8_t val) {
	if (listener_callback) {
		listener_callback(json_name, val);
	}
}

void set_output(uint32_t index, uint8_t value, int64_t timer) {
	__ASSERT(index < NUM_OUTPUTS, "invalid index for set_output");
	if (gpio_pin_set(outputs[index].dev, outputs[index].index, value)) {
		LOG_ERR("Failed to set output\n");
	}
	outputs[index].value = value;
	outputs[index].timer = timer > 0 ? k_uptime_get() + timer : 0;
	gpio_listener(outputs[index].json_name, value);
}

bool get_input_state(uint32_t index) {
	__ASSERT(index < NUM_INPUTS, "invalid index for get_input_state");
	return gpio_pin_get(get_input(index)->dev, get_input(index)->index);
}

void input_callback(const struct device *dev, struct gpio_callback *cb, uint32_t pins)
{
	for (uint32_t i = 0; i < NUM_INPUTS; i++) {
		if (get_input(i)->dev == dev && (pins & BIT(get_input(i)->index))) {
			gpio_listener(get_input(i)->json_name, get_input_state(i));
		}
	}
}

void setup_input(uint32_t index, const char * const json_name, const char * const port, const uint8_t pin_index) {
	if (index < NUM_INPUTS) {
		inputs[index].json_name = json_name;
		inputs[index].dev = device_get_binding(port);
		inputs[index].index = pin_index;

		if (inputs[index].dev == NULL) {
			LOG_ERR("Failed to get device for %s\n", inputs[index].json_name);
		} else if (0 != gpio_pin_configure(inputs[index].dev, inputs[index].index, GPIO_INPUT)) {
			LOG_ERR("Failed to configure input\n");
		} else if (0 != gpio_pin_interrupt_configure(inputs[index].dev, pin_index, GPIO_INT_EDGE_BOTH))
			LOG_ERR("Failed to enable interrupt for input\n");	
		} else {
		LOG_ERR("Invalid index for input: %s\n", json_name);
	}
}

void setup_output(const uint32_t index, 
                  const char * const json_name, 
						const char * const port, 
						const uint8_t pin_index, 
						const uint8_t value,
						const int64_t timer) {
	if (index < NUM_OUTPUTS) {
		outputs[index].json_name = json_name;
		outputs[index].dev = device_get_binding(port);
		outputs[index].index = pin_index;
		outputs[index].default_value = value; // the value for setup should be also the default value

		if (outputs[index].dev == NULL) {
			LOG_ERR("Failed to get device for %s\n", outputs[index].json_name);
		} else if (0 != gpio_pin_configure(outputs[index].dev, outputs[index].index, GPIO_OUTPUT)) {
			LOG_ERR("Failed to configure output\n");
		} else {
			set_output(index, value, timer);
		}
		
		 if (gpio_pin_set(outputs[index].dev, outputs[index].index, outputs[index].value)) {
			LOG_ERR("Failed to set output\n");
		}
	} else {
		LOG_ERR("Invalid index for output: %s\n", json_name);
	}
}

void check_output_timer() {
	int64_t now = k_uptime_get();
	for (uint32_t i = 0; i < NUM_OUTPUTS; i++) {
		if ((outputs[i].timer > 0) && (now >= outputs[i].timer)) {
			set_output(i, !outputs[i].value, 0);
		}
	}
}

void init_gpios() {
	LOG_INF("Initializing GPIOs");
	uint32_t i = 0;
	setup_output(i++, "green led", "GPIOB", 0, 0, 0);
	setup_output(i++, "orange led", "GPIOE", 1, 0, 0);
	setup_output(i++, "red led", "GPIOB", 14, 0, 0);
	__ASSERT(i == NUM_OUTPUTS, "Setup %d outputs instead of %d\n", i, NUM_OUTPUTS);

	i = 0;
	setup_input(i++, "button", "GPIOC", 13);
	__ASSERT(i == NUM_OUTPUTS, "Setup %d inputs instead of %d\n", i, NUM_INPUTS);

	//TODO make this more generic - not sure, if one input_cb_data per port is needed
	// foreach port get relevant inputs and generate mask and init callback
	gpio_init_callback(&input_cb_data, input_callback, -1);
	gpio_add_callback(inputs[0].dev, &input_cb_data);
}

struct output_struct const * const get_output(uint32_t index) {
   return &outputs[index];
}

struct input_struct const * const get_input(uint32_t index) {
   return &inputs[index];
}

int32_t get_output_by_name(const char * const json_name) {
	for (uint32_t i = 0; i < NUM_OUTPUTS; i++) {
		if (0 == strcmp(outputs[i].json_name, json_name)) {
			return i;
		}
	}
	return -1;
}

bool set_output_by_name(const char * const json_name, const uint8_t value, int64_t timer) {
	int32_t index = get_output_by_name(json_name);
	if (index >= 0) {
		set_output(index, value, timer);
	}
	return index >= 0;
}
```

## src/mygpio.h
```c
#ifndef MY_GPIO_H_
#define MY_GPIO_H_

#include <zephyr.h>
#include <posix/time.h>

#ifdef __cplusplus
extern "C" {
#endif

struct output_struct {
	const char* json_name;
	const struct device *dev;
	uint8_t index;
	uint8_t value;
   uint8_t default_value;
	int64_t timer;
};

#define NUM_OUTPUTS 3

struct input_struct {
	const char* json_name;
	const struct device *dev;
	uint8_t index;
};

#define NUM_INPUTS 1


extern void init_gpios();
extern void check_output_timer();
extern void set_output(uint32_t index, uint8_t value, int64_t timer);
extern bool get_input_state(uint32_t index);
extern bool set_output_by_name(const char * const json_name, const uint8_t value, int64_t timer);
extern int32_t get_output_by_name(const char * const json_name);
extern struct output_struct const * const get_output(uint32_t index);
extern struct input_struct const * const get_input(uint32_t index);
extern void mygpio_register_listener(void(*fun_ptr)(const char*, uint8_t));

#ifdef __cplusplus
}
#endif

#endif /* MY_GPIO_H_ */
```

## src/mysettings.c
```c
#include <shell/shell.h>
#include <drivers/flash.h>
#include <stdlib.h>
#include <power/reboot.h>
#include "mysettings.h"

#define FLASH_START_ADDR 0x8000000 // TODO read from devicetree
#define MY_SETTINGS_FLASH_OFFSET 0x1F0000u
#define MY_SETTINGS_MAGIC_ID 0x487F934Au


// this is not a random mac address, but is used to "overload" setting of the mac address
void gen_random_mac(uint8_t *mac_addr, uint8_t b0, uint8_t b1, uint8_t b2)
{
	struct mysettings const * const cfg = get_settings();
	for (uint32_t i = 0; i < 6; i++) {
		mac_addr[i] = cfg->mac_address[i];
	}
}

static struct mysettings default_settings = {
   .magic = MY_SETTINGS_MAGIC_ID,
   .flash_counter = 1,
   .sntp_server = "192.168.0.1",
   .mac_address = {0x00,0x80,0xE1,0x04,0x05,0x06}
};


struct mysettings const * const get_settings() {
   struct mysettings const * const cfg = (struct mysettings*)(FLASH_START_ADDR + MY_SETTINGS_FLASH_OFFSET);
   return cfg->magic == MY_SETTINGS_MAGIC_ID ? cfg : &default_settings;
}

static int store_settings(const struct shell *shell, struct mysettings const * const p_cfg) {
	const struct device *flash_dev;
   const struct mysettings cfg = *p_cfg;

	flash_dev = device_get_binding(DT_CHOSEN_ZEPHYR_FLASH_CONTROLLER_LABEL);
	if (!flash_dev) {
		shell_error(shell, "Flash driver was not found!");
		return -ENODEV;
	}

	flash_write_protection_set(flash_dev, false);

	if (flash_erase(flash_dev, MY_SETTINGS_FLASH_OFFSET, sizeof(cfg))) {
		shell_error(shell, "Erase internal ERROR!");
      return -EIO;
	}

	if (flash_write(flash_dev, MY_SETTINGS_FLASH_OFFSET, &cfg, sizeof(cfg)) != 0) {
		shell_error(shell, "Write internal ERROR!");
		return -EIO;
	}

	flash_write_protection_set(flash_dev, true);

	return 0;
}

static int cmd_show(const struct shell *shell, size_t argc, char **argv) {
   struct mysettings const * const cfg = get_settings();

	shell_fprintf(shell, SHELL_NORMAL, "SNTP server: %s\n", cfg->sntp_server);
	shell_fprintf(shell, SHELL_NORMAL, "MAC address: %02X:%02X:%02X:%02X:%02X:%02X\n", 
      cfg->mac_address[0], cfg->mac_address[1], cfg->mac_address[2], cfg->mac_address[3], cfg->mac_address[4], cfg->mac_address[5]);
	return 0;
}

static int cmd_sntp(const struct shell *shell, size_t argc, char **argv) {
	int ret_val = 0;
   if ((argc == 2) && (strlen(argv[1]) < (sizeof(default_settings.sntp_server) - 1))) {
      struct mysettings cfg = *get_settings();
      strcpy(cfg.sntp_server, argv[1]);
      ret_val = store_settings(shell, &cfg);
   } else {
   	shell_error(shell, "invalid syntax: settings sntp <servername>\n");
   }
   return ret_val;
}

static int cmd_mac(const struct shell *shell, size_t argc, char **argv) {
	int ret_val = 0;
   if ((argc == 2) && (strlen(argv[1]) == (6*2+5) 
			&& argv[1][2] == ':' && argv[1][5] == ':' && argv[1][8] == ':' && argv[1][11] == ':' && argv[1][14] == ':' )) {
      struct mysettings cfg = *get_settings();
		char* startptr = argv[1], *endptr;
		for (uint32_t i = 0; i < 6; i++) {
			cfg.mac_address[i] = (uint8_t)strtoul(startptr, &endptr, 16);
			startptr = endptr + 1;
		}
      ret_val = store_settings(shell, &cfg);
   } else {
   	shell_error(shell, "invalid syntax: settings mac <xx:xx:xx:xx:xx:xx>\n");
   }
	return 0;
}

SHELL_STATIC_SUBCMD_SET_CREATE(sub_settings,
	SHELL_CMD(show, NULL, "Show all settings", cmd_show),
	SHELL_CMD(sntp, NULL, "Set SNTP server", cmd_sntp),
	SHELL_CMD(mac, NULL, "Set SNTP server", cmd_mac),
	SHELL_SUBCMD_SET_END
);

SHELL_CMD_REGISTER(settings, &sub_settings, "Setting commands", NULL);
```

## src/mysettings.h
```c
#ifndef MY_SETTINGS_H_
#define MY_SETTINGS_H_

#include <zephyr.h>

#ifdef __cplusplus
extern "C" {
#endif

struct mysettings {
   uint32_t magic;
   uint32_t flash_counter;
   char sntp_server[64];
   uint8_t mac_address[6];
};

struct mysettings const * const get_settings();

#ifdef __cplusplus
}
#endif

#endif /* MY_SETTINGS_H_ */
```

## src/web_shell.c
```c
/*
 * Shell backend used for testing
 *
 * Copyright (c) 2018 Nordic Semiconductor ASA
 *
 * SPDX-License-Identifier: Apache-2.0
 */

#include "web_shell.h"
#include <init.h>

SHELL_DUMMY_DEFINE(shell_transport_dummy);
SHELL_DEFINE(shell_dummy, "http:~$", &shell_transport_dummy, 1,
	     0, SHELL_FLAG_OLF_CRLF);

static int init(const struct shell_transport *transport,
		const void *config,
		shell_transport_handler_t evt_handler,
		void *context)
{
	struct shell_dummy *sh_dummy = (struct shell_dummy *)transport->ctx;

	if (sh_dummy->initialized) {
		return -EINVAL;
	}

	sh_dummy->initialized = true;

	return 0;
}

static int uninit(const struct shell_transport *transport)
{
	struct shell_dummy *sh_dummy = (struct shell_dummy *)transport->ctx;

	if (!sh_dummy->initialized) {
		return -ENODEV;
	}

	sh_dummy->initialized = false;

	return 0;
}

static int enable(const struct shell_transport *transport, bool blocking)
{
	struct shell_dummy *sh_dummy = (struct shell_dummy *)transport->ctx;

	if (!sh_dummy->initialized) {
		return -ENODEV;
	}

	return 0;
}

static int write(const struct shell_transport *transport,
		 const void *data, size_t length, size_t *cnt)
{
	struct shell_dummy *sh_dummy = (struct shell_dummy *)transport->ctx;
	size_t store_cnt;

	if (!sh_dummy->initialized) {
		*cnt = 0;
		return -ENODEV;
	}

	store_cnt = length;
	if (sh_dummy->len + store_cnt >= sizeof(sh_dummy->buf)) {
		store_cnt = sizeof(sh_dummy->buf) - sh_dummy->len - 1;
	}
	memcpy(sh_dummy->buf + sh_dummy->len, data, store_cnt);
	sh_dummy->len += store_cnt;

	*cnt = length;

	return 0;
}

static int read(const struct shell_transport *transport,
		void *data, size_t length, size_t *cnt)
{
	struct shell_dummy *sh_dummy = (struct shell_dummy *)transport->ctx;

	if (!sh_dummy->initialized) {
		return -ENODEV;
	}

	*cnt = 0;

	return 0;
}

const struct shell_transport_api shell_dummy_transport_api = {
	.init = init,
	.uninit = uninit,
	.enable = enable,
	.write = write,
	.read = read
};

static int enable_shell_dummy(const struct device *arg)
{
	ARG_UNUSED(arg);
	shell_init(&shell_dummy, NULL, false, false, LOG_LEVEL_INF);
	return 0;
}
SYS_INIT(enable_shell_dummy, POST_KERNEL, 0);

const struct shell *shell_backend_dummy_get_ptr(void)
{
	return &shell_dummy;
}

const char *shell_backend_dummy_get_output(const struct shell *shell,
					   size_t *sizep)
{
	struct shell_dummy *sh_dummy = (struct shell_dummy *)shell->iface->ctx;

	sh_dummy->buf[sh_dummy->len] = '\0';
	*sizep = sh_dummy->len;
	sh_dummy->len = 0;

	return sh_dummy->buf;
}

void shell_backend_dummy_clear_output(const struct shell *shell)
{
	struct shell_dummy *sh_dummy = (struct shell_dummy *)shell->iface->ctx;

	sh_dummy->buf[0] = '\0';
	sh_dummy->len = 0;
}
```

## src/web_shell.h
```c
/*
 * Shell backend used for testing
 *
 * Copyright (c) 2018 Nordic Semiconductor ASA
 *
 * SPDX-License-Identifier: Apache-2.0
 */

#ifndef SHELL_DUMMY_H__
#define SHELL_DUMMY_H__

#include <shell/shell.h>

#ifdef __cplusplus
extern "C" {
#endif

extern const struct shell_transport_api shell_dummy_transport_api;

struct shell_dummy {
	bool initialized;

	/** current number of bytes in buffer (0 if no output) */
	size_t len;

	/** output buffer to collect shell output */
	char buf[2048];
};

#define SHELL_DUMMY_DEFINE(_name)					\
	static struct shell_dummy _name##_shell_dummy;			\
	struct shell_transport _name = {				\
		.api = &shell_dummy_transport_api,			\
		.ctx = (struct shell_dummy *)&_name##_shell_dummy	\
	}

/**
 * @brief This function shall not be used directly. It provides pointer to shell
 *	  dummy backend instance.
 *
 * Function returns pointer to the shell dummy instance. This instance can be
 * next used with shell_execute_cmd function in order to test commands behavior.
 *
 * @returns Pointer to the shell instance.
 */
const struct shell *shell_backend_dummy_get_ptr(void);

/**
 * @brief Returns the buffered output in the shell and resets the pointer
 *
 * The returned data is always followed by a nul character at position *sizep
 *
 * @param shell	Shell pointer
 * @param sizep	Returns size of data in shell buffer
 * @returns pointer to buffer containing shell output
 */
const char *shell_backend_dummy_get_output(const struct shell *shell,
					   size_t *sizep);

/**
 * @brief Clears the output buffer in the shell backend.
 *
 * @param shell	Shell pointer
 */
void shell_backend_dummy_clear_output(const struct shell *shell);

#ifdef __cplusplus
}
#endif

#endif /* SHELL_DUMMY_H__ */
```
